## firmware/main/Kconfig.projbuild
```kconfig
menu "Drone navigation"

config DRONE_NAV_CONFIDENCE_PERCENT
    int "Minimum command confidence (%)"
    range 1 100
    default 72

config DRONE_NAV_CONFIRM_FRAMES
    int "Consecutive frames required for movement"
    range 1 10
    default 3

config DRONE_NAV_FRAME_INTERVAL_MS
    int "Delay between frames (ms)"
    range 0 1000
    default 30

config DRONE_NAV_TENSOR_ARENA_KB
    int "TFLite tensor arena size (KiB)"
    range 128 1024
    default 320

menu "Flight controller UART"

config DRONE_NAV_UART_PORT
    int "UART port"
    range 0 2
    default 2

config DRONE_NAV_UART_TX_PIN
    int "UART TX GPIO"
    range 0 48
    default 14

config DRONE_NAV_UART_RX_PIN
    int "UART RX GPIO"
    range 0 48
    default 15

config DRONE_NAV_UART_BAUD
    int "UART baud rate"
    default 115200

endmenu

menu "OV2640 camera pins (AI-Thinker ESP32-CAM mapping)"

config DRONE_CAM_PIN_PWDN
    int "PWDN GPIO (-1 if unused)"
    range -1 48
    default 32
config DRONE_CAM_PIN_RESET
    int "RESET GPIO (-1 if unused)"
    range -1 48
    default -1
config DRONE_CAM_PIN_XCLK
    int "XCLK GPIO"
    range 0 48
    default 0
config DRONE_CAM_PIN_SIOD
    int "SIOD/SDA GPIO"
    range 0 48
    default 26
config DRONE_CAM_PIN_SIOC
    int "SIOC/SCL GPIO"
    range 0 48
    default 27
config DRONE_CAM_PIN_D0
    int "D0/Y2 GPIO"
    range 0 48
    default 5
config DRONE_CAM_PIN_D1
    int "D1/Y3 GPIO"
    range 0 48
    default 18
config DRONE_CAM_PIN_D2
    int "D2/Y4 GPIO"
    range 0 48
    default 19
config DRONE_CAM_PIN_D3
    int "D3/Y5 GPIO"
    range 0 48
    default 21
config DRONE_CAM_PIN_D4
    int "D4/Y6 GPIO"
    range 0 48
    default 36
config DRONE_CAM_PIN_D5
    int "D5/Y7 GPIO"
    range 0 48
    default 39
config DRONE_CAM_PIN_D6
    int "D6/Y8 GPIO"
    range 0 48
    default 34
config DRONE_CAM_PIN_D7
    int "D7/Y9 GPIO"
    range 0 48
    default 35
config DRONE_CAM_PIN_VSYNC
    int "VSYNC GPIO"
    range 0 48
    default 25
config DRONE_CAM_PIN_HREF
    int "HREF GPIO"
    range 0 48
    default 23
config DRONE_CAM_PIN_PCLK
    int "PCLK GPIO"
    range 0 48
    default 22

endmenu
endmenu
```

## firmware/sdkconfig.defaults
```kconfig
CONFIG_ESP_DEFAULT_CPU_FREQ_MHZ_240=y
CONFIG_SPIRAM=y
CONFIG_SPIRAM_MODE_QUAD=y
CONFIG_SPIRAM_SPEED_80M=y
CONFIG_SPIRAM_USE_MALLOC=y
CONFIG_COMPILER_OPTIMIZATION_PERF=y
CONFIG_ESPTOOLPY_FLASHSIZE_4MB=y
CONFIG_PARTITION_TABLE_SINGLE_APP_LARGE=y
```
